## drivers/motor/Kconfig
```kconfig
menuconfig MOTOR
    bool "MOTOR for vibration motor"
    depends on SPI 
    help
        Enable driver for SPI-based vibration motor

if MOTOR 

module = MOTOR
module-str = motor
source "subsys/logging/Kconfig.template.log_config"

config MOTOR_INIT_PRIORITY
    int "Motor init priority"
    default 90
    help
        Motor initialization priority for the driver

choice 
        prompt "MOTOR timer input capture mode"
        default MOTOR_NO_INPUT_CAPTURE_MODE
        help
                Select the input capture mode for the motor transfer. 
config MOTOR_NO_INPUT_CAPTURE_MODE
        bool "no arch specific implementation"
config MOTOR_STM32_INPUT_CAPTURE_MODE
        bool "STM32 input capture mode"
        depends on SOC_FAMILY_STM32
        select USE_STM32_LL_TIM
        select USE_STM32_LL_RCC if SOC_SERIES_STM32F4X || SOC_SERIES_STM32F7X || SOC_SERIES_STM32H7X
endchoice 

        
endif # MOTOR
```

## drivers/sensor/bno055/Kconfig
```kconfig
# BMP280 temperature and pressure sensor configuration options

# Copyright (c) 2016 Intel Corporation
# Copyright (c) 2017 IpTronix S.r.l.
# SPDX-License-Identifier: Apache-2.0

menuconfig BNO055
	bool "BNO055 sensor"
	depends on I2C
	help
	  Enable driver for BNO055 I2C-based accelerometer, gyroscope, magnetometer and orientation.

if BNO055

choice 
       prompt "BNO055 operation Mode"
       default BNO055_OPERATION_MODE_NDOF 
       help 
         Operation mode 
config BNO055_OPERATION_MODE_CONFIG
        bool "0X00"
config BNO055_OPERATION_MODE_ACCONLY
        bool "0X01"
config BNO055_OPERATION_MODE_MAGONLY
        bool "0X02"
config BNO055_OPERATION_MODE_GYRONLY
        bool "0X03"
config BNO055_OPERATION_MODE_ACCMAG
        bool "0X04"
config BNO055_OPERATION_MODE_ACCGYRO
        bool "0X05"
config BNO055_OPERATION_MODE_MAGGYRO
        bool "0X06"
config BNO055_OPERATION_MODE_AMG
        bool "0X07"
config BNO055_OPERATION_MODE_IMUPLUS
        bool "0X08"
config BNO055_OPERATION_MODE_COMPASS
        bool "0X09"
config BNO055_OPERATION_MODE_M4G
        bool "0X0A"
config BNO055_OPERATION_MODE_NDOF_FMC_OFF
        bool "0X0B"
config BNO055_OPERATION_MODE_NDOF
        bool "0X0C"
endchoice

endif # BNO055
```

## dts/bindings/motor/thm,motor-spi.yaml
```yaml
description: MOTOR motor for vibration

compatible: "thm,motor"

include: spi-device.yaml

properties:
        
        
        tim:
                type: phandle
                required: false
        
        pinctrl-0:
                type: phandles
                required: false
                description: |
                        channel 1 or 2 for clk, channel 3 to 6 for save 
                        e.g. pinctrl-0 = < &tim_ch1_pb4 &tim3_ch4_pb1 >;
                        first label would be clk and second for save
                        
        chain-length:
                type: int
                required: true
                description: |
                       The number of motors in the daisy-chain
```

## dts/bindings/sensor/bosch,bno055-i2c.yaml
```yaml
# SPDX-License-Identifier: Apache-2.0

description: BME280 integrated environmental sensor

compatible: "bosch,bno055"

include: i2c-device.yaml
```
